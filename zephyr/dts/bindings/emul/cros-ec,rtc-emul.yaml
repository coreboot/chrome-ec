## zephyr/dts/bindings/emul/cros-ec,rtc-emul.yaml
```yaml
# Copyright 2022 The ChromiumOS Authors
# Use of this source code is governed by a BSD-style license that can be
# found in the LICENSE file.

description: Emulator for Chromiumos EC real-time-clock (RTC).

compatible: "cros-ec,rtc-emul"

include: base.yaml
```

## zephyr/test/dsp_comms/testcase.yaml
```yaml
tests:
  pw_fsm.state_machine:
    harness: gtest
    extra_args:
      - TEST_LIB=pw_fsm.fsm_test
    platform_allow:
      - native_sim
  pw_transport.service:
    harness: gtest
    extra_args:
      - TEST_LIB=pw_transport.service_test
      - PW_TRANSPORT_STATUS_FLAGS_SIZE=2
    platform_allow:
      - native_sim
```
