/* Copyright 2024 The ChromiumOS Authors
 * Use of this source code is governed by a BSD-style license that can be
 * found in the LICENSE file.
 */

/* fatcat program common DTS includes */

#include <cros/integrated_fwid.dtsi>

/* fatcat_npcx9m7f project DTS includes */

#include <cros/cbi_flash.dtsi>

#include "generated.dtsi"

#include "adc.dtsi"
#include "gpios.dtsi"
#include "i2c.dtsi"

#include "../fatcat_it82002aw/gsc_board.dtsi"
#include "../fatcat_it82002aw/interrupts.dtsi"

#define CHARGER_I2C i2c2_0
#define PD_POW_I2C i2c0_0

#include "../../intelrvp/ptlrvp/i2c.dtsi"
#include "../../intelrvp/ptlrvp/keyboard.dtsi"

/* fatcat_npcx9m7f overrides follow... */

&cbi_flash {
	/*
	 * CBI section size is 0x1000 bytes, the CBI portion lies at the end of
	 * EC_RO section. EC_RO section ends at 0x50000 byte which is the offset
	 */
	offset = <0x50000>;
	size = <0x1000>;
};

/* AP interface */
&espi0 {
	status = "okay";
	pinctrl-0 = <&espi_lpc_gp46_47_51_52_53_54_55_57>;
	pinctrl-names = "default";
};
