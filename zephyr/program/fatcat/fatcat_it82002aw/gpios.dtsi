/* Copyright 2024 The ChromiumOS Authors
 * Use of this source code is governed by a BSD-style license that can be
 * found in the LICENSE file.
 */

/ {
	aliases {
		gpio-wp = &gpio_ec_write_protect;
	};
};

/*
 * Aliases to common names
 */
gpio_ec_pch_wake_odl: &gpio_smc_wake_sci_n_r {};
cse_early_rec_sw: &gpio_x00085 {};
