/* Copyright 2024 The ChromiumOS Authors
 * Use of this source code is governed by a BSD-style license that can be
 * found in the LICENSE file.
 */

/ {
	fans {
		compatible = "cros-ec,fans";

		fan0: fan0 {
			pwms = <&pwm2 0 PWM_KHZ(324) PWM_POLARITY_NORMAL>;
			tach = <&tach0>;
			rpm_min = <1000>;
			rpm_start = <1000>;
			rpm_max = <4000>;
			enable_gpio = <&gpio_en_pp5000_fan>;
			rpm_deviation = <1>;
			use_fast_start;
		};
	};
};

&tach0 {
	status = "okay";
	pinctrl-0 = <&tach0a_gpd6_default>;
	pinctrl-names = "default";
	channel = <IT8XXX2_TACH_CHANNEL_A>;
	pulses-per-round = <2>;
};
